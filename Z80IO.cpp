/*** Z80Em: Portable Z80 emulator *******************************************/
/***                                                                      ***/
/***                                Z80IO.h                               ***/
/***                                                                      ***/
/*** This file contains the prototypes for the functions accessing memory ***/
/*** and I/O                                                              ***/
/***                                                                      ***/
/*** Copyright (C) Marcel de Kogel 1996,1997                              ***/
/***     You are not allowed to distribute this software commercially     ***/
/***     Please, notify me, if you make any changes to this file          ***/
/****************************************************************************/

/****************************************************************************/
/* Input a byte from given I/O port                                         */
/****************************************************************************/

#include "Arduino.h"
#include "Z80.h"

extern byte z80ports_in[16];
extern byte *bank1;
extern byte *bank2;
extern byte *bank3;

static byte lynxrom[16384] = 
{
    0xF3, 0x3E, 0x20, 0xD3, 0x80, 0xC3, 0x3B, 0x00, 0xC3, 0x1B, 0x35, 0x20, 0x4C, 0x30, 0x31, 0x34, 
    0x1A, 0xFE, 0x20, 0xC0, 0x13, 0x18, 0xF9, 0x00, 0xC3, 0x63, 0x23, 0x53, 0x75, 0x73, 0x79, 0x00, 
    0xE3, 0xBE, 0x23, 0xE3, 0xC8, 0xCD, 0x3B, 0x3B, 0xC3, 0x59, 0x20, 0x00, 0x00, 0x00, 0x00, 0x00, 
    0xC3, 0x64, 0x3B, 0xE1, 0xE9, 0x00, 0x00, 0x00, 0xC3, 0x97, 0x62, 0xAF, 0x01, 0x7F, 0xFF, 0xED, // old CRTC init
//-    0xC3, 0x64, 0x3B, 0xE1, 0xE9, 0x00, 0x00, 0x00, 0xC3, 0x97, 0x62, 0xcd, 0x00, 0x78, 0xcd, 0x10, // jump to CLS (actually llink on)
    0x79, 0x06, 0x10, 0x21, 0x56, 0x00, 0xAF, 0xD3, 0x86, 0x08, 0x7E, 0xD3, 0x87, 0x08, 0x3C, 0x23, // was endbbyte of crtc init
//-    0x78, 0x06, 0x10, 0x21, 0x56, 0x00, 0xAF, 0xD3, 0x86, 0x08, 0x7E, 0xD3, 0x87, 0x08, 0x3C, 0x23, // endbyte of jump cont

    0x10, 0xF5, 0xC3, 0x8C, 0x16, 0x00, 0x2F, 0x20, 0x26, 0x33, 0x4D, 0x02, 0x3F, 0x44, 0x00, 0x03, 
    0x03, 0x03, 0x00, 0x00, 0x07, 0xDF, 0xC3, 0x94, 0x62, 0x3E, 0xE8, 0x08, 0x3E, 0x63, 0x18, 0x05, 
    0x3E, 0xE4, 0x08, 0x3E, 0x65, 0x01, 0x7F, 0xFF, 0xED, 0x79, 0x3E, 0x40, 0xD3, 0x80, 0x08, 0xD3, 
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    0x7F, 0xFF, 0xED, 0x79, 0xC9, 0x3E, 0x20, 0xD3, 0x80, 0xED, 0x5B, 0x5C, 0x62, 0xCD, 0x26, 0x09,   // CLS at 08e5 starts 3e 20
//    0x7F, 0xFF, 0xED, 0x79, 0xC9, 0xc9, 0x20, 0xD3, 0x80, 0xED, 0x5B, 0x5C, 0x62, 0xCD, 0x26, 0x09,  // CLS replaced with RET
//    0x7F, 0xFF, 0xED, 0x79, 0xC9, 0xcd, 0x00, 0x78, 0xcd, 0x10, 0x78, 0xc9, 0x62, 0xCD, 0x26, 0x09,  // CLS replaced with call to lynxlink7
    0x3A, 0x6B, 0x62, 0x0F, 0x38, 0x08, 0x2A, 0x8E, 0x62, 0x3E, 0x23, 0xCD, 0xCF, 0x08, 0xCD, 0x26, 
    0x09, 0x3A, 0x6B, 0x62, 0xCB, 0x4F, 0x20, 0x08, 0x2A, 0x90, 0x62, 0x3E, 0x23, 0xCD, 0xCF, 0x08, 
    0xCD, 0x26, 0x09, 0x3A, 0x6B, 0x62, 0xCB, 0x57, 0x20, 0x08, 0x2A, 0x92, 0x62, 0x3E, 0x25, 0xCD, 
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    0xF3, 0xF4, 0xF5, 0xF6, 0xF7, 0xF8, 0xF9, 0x19, 0x0A, 0x0A, 0x0D, 0x00, 0x1A, 0x13, 0xFE, 0x7C, // startup logo orig 2

//    0x9A, 0x00, 0xC3, 0xE2, 0x10, 0xC3, 0x5C, 0x2D, 0x00, 0x3a, 0x3a, 0x3a, 0x3a, 0x3a, 0x3a, 0x3a, // startup logo
//    'L', 'Y', 'N', 'X', 0x3a, 0x3a, 0x3a, 0x3a, 0x0A, 0x0A, 0x0D, 0x00, 0x1A, 0x13, 0xFE, 0x7C, // startup logo 
    0x28, 0x1D, 0xFE, 0x79, 0x28, 0x19, 0xFE, 0x85, 0x28, 0xF2, 0xFE, 0x87, 0x28, 0xEE, 0xFE, 0x86, 
    0x28, 0xEA, 0xFE, 0x7A, 0x28, 0x03, 0xFE, 0x7E, 0xC0, 0x13, 0x13, 0x13, 0x13, 0x13, 0xC9, 0xCD, 
    0xFC, 0x17, 0xFE, 0x7B, 0x20, 0xF9, 0xC9, 0xD5, 0xCD, 0x08, 0x28, 0xD1, 0xC9, 0x1A, 0xFE, 0x7C, 
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    0x2A, 0x04, 0x62, 0xC5, 0x01, 0x39, 0x20, 0xC5, 0xE9, 0xC1, 0xE1, 0xC9, 0x4F, 0x3A, 0x06, 0x62, // print char at 4f 3a 06
 //   0x2A, 0x04, 0x62, 0xC5, 0x01, 0x39, 0x20, 0xC5, 0xE9, 0xC1, 0xE1, 0xC9, 0xd3, 0x94, 0xc9, 0x62, // printchar replaced with out 94,x
    0xC5, 0xF5, 0xE6, 0x81, 0x28, 0x09, 0x79, 0x2A, 0x00, 0x62, 0x01, 0x4F, 0x20, 0xC5, 0xE9, 0xF1, 
    0xC1, 0xE6, 0x82, 0xC8, 0x79, 0x2A, 0x02, 0x62, 0xE9, 0x1A, 0xE7, 0x7D, 0xC3, 0xAF, 0x62, 0xDF, 
    0xE5, 0x1A, 0xFE, 0x0D, 0x28, 0x02, 0x13, 0xDF, 0xDD, 0xE1, 0x01, 0x70, 0x20, 0xC5, 0xDD, 0xE9, 
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    0x2F, 0x17, 0xD4, 0x6D, 0x36, 0x21, 0xFB, 0x35, 0xCD, 0xBA, 0x35, 0xC3, 0x6D, 0x36, 0xFF, 0x00     
} ;


byte Z80_In (uint16_t Port)
{
  if((Port & 0x00ff)  == 0x0080)
  {
    int16_t kbdportvalmasked = (Port & 0x0f00);
    int16_t kbdarrno = kbdportvalmasked >> 8;
/*
    Serial.print("inport ");
    Serial.print(Port, HEX);
    Serial.print("kbdportvalmasked ");
    Serial.print(kbdportvalmasked, HEX);
    Serial.print("kbdarrno ");
    Serial.print(kbdarrno, HEX);
    Serial.print("val= ");
    Serial.println(z80ports_in[kbdarrno], HEX);
*/
    return( z80ports_in[kbdarrno] );
  }
  return 0xff;
}

byte bank_latch = 0x00;
byte vid_latch = 0x00;


/****************************************************************************/
/* Output a byte to given I/O port                                          */
/****************************************************************************/
void Z80_Out (uint16_t Port,byte Value)
{
//  if ((Port & 0x207f)==0x207F)Port=0x7f;
  Port = Port & 0xFF;
  switch (Port) 
  {
    case 0x7F:
    {
      //Serial.print("Setting bank latch to ");
      //Serial.println(Value,HEX);
      bank_latch = Value;
      break;
    }
    case 0x80:
    {
      //Serial.print("Setting VIDEO latch to ");
      //Serial.println(Value,HEX);
      vid_latch = Value;
      break;
    }
//    case 0x94:    // serial output from lynx rom instead of bitmap - used with ROM mods
//    {
//      Serial.write(Value);
//      break;
//    }    
  }
  
}



byte Z80_RDMEM(uint16_t A)
{
//  Serial.print("RDMEM A is ");
//  Serial.print(A);
//  Serial.print("  bank latch is ");
//  Serial.println(bank_latch);
//  
  if((bank_latch & 0x10) == 0x00)
  {
    if (A < 0x4000)
    {
//        Serial.print("Returning ");
//        Serial.println(A);
        return lynxrom[A];
    }
  }

  if((bank_latch & 0x20) == 0x00)  // BANK 1  user ram
  {
    if(A >= 0x6000 && A < 0xa000)
      return bank1[A - 0x6000];
    else
      return 0xff;
  }

  if((bank_latch & 0x40) == 0x40)   // BANK 2 video 
  {
    if((vid_latch & 0x04) == 0x00)
    {
        if(A<0x4000 || (A > 0x8000 && A < 0xc000))
          return bank2[A % 0x2000];        // mirror
        else if((A>=0x4000 && A<0x8000) || A >=0xc000)
          return bank2[0x2000+(A % 0x2000)];       // BLUE RED
      // return bank2[A];
    }
    if((vid_latch & 0x08) == 0x00)
    {
      A = A % 0x2000;
      return bank3[A];
    }
  }
 
  return 0xff;        
}

  #include <stdint.h>


void Z80_WRMEM(uint16_t A,byte V)
{
     if((bank_latch & 0x01)==0)
    {
      if(A >= 0x6000 && A < 0xa000)
      {
//        Serial.print("writing address ");
//        Serial.print(A,HEX);
//        Serial.print("with ");
//        Serial.print(V,HEX);
//        
        bank1[A - 0x6000]=V;

//        Serial.print("  result in A is  ");
//        Serial.println(bank1[A - 0x6000],HEX);

      }
    }
    if((bank_latch & 0x02)==0x02)
    {
      if ((vid_latch & 0x04)==0) 
      {
/*
//        if(run_viddebug)        
//        {
//          Serial.print("BLUERED at ");
//          Serial.print(A,HEX);
//          Serial.print("  write with ");
//          Serial.print(V,HEX);
//        }
             A = A % 0x4000;
             
 
//          Serial.print("  bank2 at ");
//          Serial.println(A,HEX);
            
             bank2[A]=V;       // BLUE RED
*/

        if(A<0x4000 || (A > 0x8000 && A < 0xc000))
          bank2[A % 0x2000]=V;        // mirror
        else if((A>=0x4000 && A<0x8000) || A >=0xc000)
          bank2[0x2000+(A % 0x2000)]=V;       // BLUE RED
  


      }
    }
    if((bank_latch & 0x04)==0x04)
    {
      if ((vid_latch & 0x08)==0) 
      {
              A = A % 0x4000;
               bank3[A]=V;       //AGREEN  GREEN
      }
    }
}


//void copy_rom()
//{
//  bank0[0] = 0x3e;
//  bank0[1] = 0x11;
//  bank0[2] = 0xc3;
//  bank0[3] = 0x00;
//  bank0[4] = 0x00;
//  
//}

/****************************************************************************/
/* Read a byte from given memory location                                   */
/****************************************************************************/
//unsigned Z80_RDMEM(unsigned int A)
//{
//  
//  return bank0[A];
//}

/****************************************************************************/
/* Write a byte to given memory location                                    */
/****************************************************************************/
//void Z80_WRMEM(unsigned int A,byte V)
//{
//  bank0[A] = V;
//}






void Z80_Patch (Z80_Regs *Regs)   /* Called when ED FE occurs. Can be used */
                                   /* to emulate disk access etc.           */
{

}
           /* This is called after IPeriod T-States */
                                   /* have been executed. It should return  */
                                   /* Z80_IGNORE_INT, Z80_NMI_INT or a byte */
                                   /* identifying the device (most often    */
                                   /* 0xFF)  */



int Z80_Interrupt(void)
{  
//   return(Z80_IGNORE_INT );
   return(0xff);

/*
  static int ii=0,jj=0;
  
  if ((start_ss_nmi==1))// || (break_nmi==1)) //not corrrect EMU
  {
    start_ss_nmi=0;
    return(Z80_NMI_INT);
  } 
  else if ( start_im1_irq==1 || (break_nmi==1))//who knows, is the key to here or what !!?
  {
      start_im1_irq=0;
      return(0xff);//IM1 interrupt device  FF - rst 38
  }
  else
    return(Z80_IGNORE_INT );*/
}



void Z80_Reti (void)
{
}/* Called when RETI occurs               */

void Z80_Retn (void)
{
  
}/* Called when RETN occurs               */





/****************************************************************************/
/* Just to show you can actually use macros as well                         */
/****************************************************************************/
/*
 extern byte *ReadPage[256];
 extern byte *WritePage[256];
 #define Z80_RDMEM(a) ReadPage[(a)>>8][(a)&0xFF]
 #define Z80_WRMEM(a,v) WritePage[(a)>>8][(a)&0xFF]=v
*/

/****************************************************************************/
/* Z80_RDOP() is identical to Z80_RDMEM() except it is used for reading     */
/* opcodes. In case of system with memory mapped I/O, this function can be  */
/* used to greatly speed up emulation                                       */
/****************************************************************************/
#define Z80_RDOP(A)    Z80_RDMEM(A)

/****************************************************************************/
/* Z80_RDOP_ARG() is identical to Z80_RDOP() except it is used for reading  */
/* opcode arguments. This difference can be used to support systems that    */
/* use different encoding mechanisms for opcodes and opcode arguments       */
/****************************************************************************/
#define Z80_RDOP_ARG(A)   Z80_RDOP(A)

/****************************************************************************/
/* Z80_RDSTACK() is identical to Z80_RDMEM() except it is used for reading  */
/* stack variables. In case of system with memory mapped I/O, this function */
/* can be used to slightly speed up emulation                               */
/****************************************************************************/
#define Z80_RDSTACK(A)    Z80_RDMEM(A)

/****************************************************************************/
/* Z80_WRSTACK() is identical to Z80_WRMEM() except it is used for writing  */
/* stack variables. In case of system with memory mapped I/O, this function */
/* can be used to slightly speed up emulation                               */
/****************************************************************************/
#define Z80_WRSTACK(A,V)  Z80_WRMEM(A,V)


//byte theRAM[16384];


//uint8 ICACHE_RODATA_ATTR 


//uint8 ICACHE_RODATA_ATTR data[] = {
//    0,1,2,3,4,5,6,7,
//    8,9,10,11,12,13,14,15
//};
// 
//uint16 ICACHE_RODATA_ATTR data16[] = {
//    300,600,900,1200
//};
// 
//uint8 ICACHE_FLASH_ATTR read_rom_uint8(const uint8* addr){
//    uint32 bytes;
//    bytes = *(uint32*)((uint32)addr & ~3);
//    return ((uint8*)&bytes)[(uint32)addr & 3];
//}
// 
//uint16 read_rom_uint16(const uint16* addr){
//    uint32 bytes;
//    bytes = *(uint32*)((uint32)addr & ~3);
//    return ((uint16*)&bytes)[((uint32)addr >> 1) & 1];
//}


void pump_key(char k)
{
  int f;
//  int PUMP_DELAY=2000;
  int PUMP_DELAY=4;


//  if key[SDLK_CAPSLOCK]) z80ports_in[0x0080] &= 0xF7;
//  if key[SDLK_UP]) z80ports_in[0x0080] &= 0xEF;
//  if key[SDLK_DOWN]) z80ports_in[0x0080] &= 0xDF;
//  if key[SDLK_ESCAPE]) z80ports_in[0x0080] &= 0xBF;
//  if ((key[SDLK_RSHIFT]) || (key[SDLK_LSHIFT])) z80ports_in[0x0080] &= 0x7F;


    k=tolower (k);
     
  // Real Keyboard Table        
  if (k=='1') z80ports_in[0] &= 0xFE;
  if (k=='!')
  {
    z80ports_in[0] &= 0x7F;//SHIFT
    z80ports_in[0] &= 0xFE;
  }

  if (k=='3') z80ports_in[1] &= 0xFE; // 01
  if(k=='#')
  {
    z80ports_in[0] &= 0x7F;//SHIFT
    z80ports_in[1] &= 0xFE;// 3
  }
  if (k=='4') z80ports_in[1] &= 0xFD;
  if(k=='$')
  {
    z80ports_in[0] &= 0x7F;//SHIFT
    z80ports_in[1] &= 0xFD;// 4
  }
// 02
  if (k=='e') z80ports_in[1] &= 0xFB;
// 04
  if (k=='x') z80ports_in[1] &= 0xF7;
// 08
  if (k=='d') z80ports_in[1] &= 0xEF;
// 10
    if (k=='c') z80ports_in[1] &= 0xDF; // 20
  if (k=='2') z80ports_in[2] &= 0xFE;
  if(k=='\"')
  {
    z80ports_in[0] &= 0x7F;//SHIFT
    z80ports_in[2] &= 0xFE;// 2
  }

  if (k=='q') z80ports_in[2] &= 0xFD;
  if (k=='w') z80ports_in[2] &= 0xFB;
  if (k=='z') z80ports_in[2] &= 0xF7;
  if (k=='s') z80ports_in[2] &= 0xEF;
  if (k=='a') z80ports_in[2] &= 0xDF;
//  if ((key[SDLK_RCTRL]) || (key[SDLK_LCTRL])) z80ports_in[0x0280] &= 0xBF;
  
  if (k=='5') z80ports_in[3] &= 0xFE;
  if(k=='%')
  {
    z80ports_in[0] &= 0x7F;//SHIFT
    z80ports_in[3] &= 0xFE;// 5
  }
  if (k=='r') z80ports_in[3] &= 0xFD;
  if (k=='t') z80ports_in[3] &= 0xFB;
  if (k=='v') z80ports_in[3] &= 0xF7;
  if (k=='g') z80ports_in[3] &= 0xEF;
  if (k=='f') z80ports_in[3] &= 0xDF;


  if (k=='6') z80ports_in[4] &= 0xFE;
  if(k=='&')
  {
    z80ports_in[0] &= 0x7F;//SHIFT
    z80ports_in[4] &= 0xFE;// 6
  }
  if (k=='y') z80ports_in[4] &= 0xFD;
  if (k=='h') z80ports_in[4] &= 0xFB;
  if (k==' ') z80ports_in[4] &= 0xF7;
  if (k=='n') z80ports_in[4] &= 0xEF;
  if (k=='b') z80ports_in[4] &= 0xDF;

  if (k=='7') z80ports_in[5] &= 0xFE;
  if(k=='\'')
  {
    z80ports_in[0] &= 0x7F;//SHIFT
    z80ports_in[5] &= 0xFE;// 7
  }
  if (k=='8') z80ports_in[5] &= 0xFD;
  if(k=='(')
  {
    z80ports_in[0] &= 0x7F;//SHIFT
    z80ports_in[5] &= 0xFD;// 8
  }
  if (k=='u') z80ports_in[5] &= 0xFB;
  if (k=='m') z80ports_in[5] &= 0xF7;
  if (k=='j') z80ports_in[5] &= 0xDF;

  if (k=='9') z80ports_in[6] &= 0xFE;
  if(k==')')
  {
    z80ports_in[0] &= 0x7F;//SHIFT
    z80ports_in[6] &= 0xFE;// 9
  }
  if (k=='i') z80ports_in[6] &= 0xFD;
  if (k=='o') z80ports_in[6] &= 0xFB;
  if (k==',') z80ports_in[6] &= 0xF7;
  if(k=='<')
  {
    z80ports_in[0] &= 0x7F;//SHIFT
    z80ports_in[6] &= 0xF7;// ,
  }

  if (k=='k') z80ports_in[6] &= 0xDF;

  if (k=='0') z80ports_in[7] &= 0xFE;

  if (k=='p') z80ports_in[7] &= 0xFD;
  if (k=='l') z80ports_in[7] &= 0xFB;

// unsure about these
  if (k=='.') z80ports_in[7] &= 0xF7;
  if(k=='>')
  {
    z80ports_in[0] &= 0x7F;//SHIFT
    z80ports_in[7] &= 0xF7;// .
  }
  if (k==';') z80ports_in[7] &= 0xDF;
  if (k=='+')
  {
    z80ports_in[0] &= 0x7F;//SHIFT ;
    z80ports_in[7] &= 0xDF;
  }
  


  if (k=='-') z80ports_in[8] &= 0xFE;
  // = key is shifted -
  if (k=='=') 
  {
    z80ports_in[0] &= 0x7F;//SHIFT -
    z80ports_in[8] &= 0xFE;
  }

//  if (k=='(') z80ports_in[0x0880] &= 0xFB;
  if (k=='/') z80ports_in[8] &= 0xF7;
  if (k=='?')
  {
    z80ports_in[0] &= 0x7F;//SHIFT /
    z80ports_in[8] &= 0xF7;
  }

  if (k==':') z80ports_in[8] &= 0xDF;
  if (k=='*')
  {
    z80ports_in[0] &= 0x7F;//SHIFT :
    z80ports_in[8] &= 0xDF;
  }

  if (k=='[') z80ports_in[8] &= 0xFB;

// Does this work? gives a n amperrsand
//  if (k=='@') z80ports_in[0x0580] &= 0xEF;


  if (k=='@') z80ports_in[8] &= 0xFD;
  if (k=='\\')
  {
    z80ports_in[0] &= 0x7F;//SHIFT @
    z80ports_in[8] &= 0xFD;
  }


  // Newline Character 13
//  if (k==')') z80ports_in[0x0980] &= 0xFD;  
  if (k==']') z80ports_in[9] &= 0xFD;
  if (k=='\x0d') z80ports_in[9] &= 0xF7;

  if (k=='`' || k == 0x1b) z80ports_in[0] &= 0xBF;  //escape key
  if(k == 0x08) z80ports_in[9] &= 0x02;

  //Make sure the keypress is recognised
  //in future check in the keyboard buffer on the ynx that they key gets there
  
  for(f=0;f<PUMP_DELAY;f++)
       Z80_Execute();
   

  // Clear all keypresses
  z80ports_in[0] = 0xFF;
  z80ports_in[1] = 0xFF;
  z80ports_in[2] = 0xFF;
  z80ports_in[3] = 0xFF;
  z80ports_in[4] = 0xFF;
  z80ports_in[5] = 0xFF;
  z80ports_in[6] = 0xFF;
  z80ports_in[7] = 0xFF;
  z80ports_in[8] = 0xFF;
  z80ports_in[9] = 0xFF;

  //Make sure the keypress is recognised
  //in future check in the keyboard buffer on the ynx that they key gets there
  for(f=0;f<PUMP_DELAY;f++)
      Z80_Execute();
   

}



